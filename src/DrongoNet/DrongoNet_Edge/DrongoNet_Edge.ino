#include "Arduino.h"

#include <mbed.h>
#include <mbed_stats.h>

// Prevent macro collision with <cmath> abs()
#ifdef abs
#undef abs
#endif
#include <cmath>

// TFLite Micro
#include "TensorFlowLite.h"
#include "tensorflow/lite/micro/all_ops_resolver.h"
#include "tensorflow/lite/micro/micro_interpreter.h"
#include "tensorflow/lite/micro/tflite_bridge/micro_error_reporter.h"
#include "tensorflow/lite/schema/schema_generated.h"

// ── Shared ARGUS helpers ─────────────────────────────────────────────────────
// DWT timing macros, fast_log10f, ArgusStageRAM profiling -- see
// libraries/ARGUS_Common/src/ARGUS_Common.h. Install this library (copy
// libraries/ARGUS_Common into your Arduino libraries folder, or open the
// .ino via the repo checkout) before compiling this sketch.
#include <ARGUS_Common.h>

// ── SDRAM (Portenta H7 — 8 MB at 0x60000000) ────────────────────────────────
#include <SDRAM.h>

// ── Mel Filterbank Tables (80 mels, matching DrongoNet-edge training) ────────
// Generated by: python generate_mel_tables.py --n_mels 80 --fmin 100.0 --fmax 8000.0
// Matches: librosa.filters.mel(sr=16000, n_fft=1024, n_mels=80, fmin=100.0, fmax=8000.0)
#include "mel_tables_80.h"

// ── CMSIS-DSP (Hardware-accelerated FFT on Cortex-M7) ────────────────────────
// arm_math.h is provided by ArduinoCore-mbed BSP for Portenta H7.
// No extra library required.
#include <arm_math.h>

// INA219 power monitor
#include <Adafruit_INA219.h>
#include <Wire.h>

// ── Model header ─────────────────────────────────────────────────────────────
// DrongoNet-edge: input tensor [1, 184, 80, 1] — (batch, time, mel, ch)
#include "seabadnet-edge.h"

// =========================================================
// Model dimensions — DrongoNet-edge
//   Tensor shape [1, 184, 80, 1] — (batch, height=time, width=mel, ch)
//   mel axis = 80 bins, time axis = 184 frames
// =========================================================
static const int MEL_BINS    = MEL_N_MELS;   // 80  (from mel_tables_80.h)
static const int TIME_FRAMES = 184;
static const int INPUT_SIZE  = MEL_BINS * TIME_FRAMES; // 80 × 184 = 14 720

// =========================================================
// Audio capture settings
// 3 s × 16 000 Hz = 48 000 samples
// =========================================================
static const int MIC_PIN           = A1;
static const int SAMPLE_RATE       = 16000;
static const int AUDIO_DURATION_MS = 3000;
static const int BUFFER_SIZE       = (SAMPLE_RATE * AUDIO_DURATION_MS) / 1000; // 48 000

// =========================================================
// melFeatures — global BSS (14720 floats = 57.5 KB).
// Stack-allocating this inside loop() would overflow the
// main-thread stack (32 KB) → HardFault.
// =========================================================
static float melFeatures[INPUT_SIZE];

// =========================================================
// audioBuffer — 48 000 × 2 B = 93.75 KB in normal BSS.
// The tensor_arena is in SDRAM, freeing AXI SRAM pressure.
// =========================================================
static int16_t audioBuffer[BUFFER_SIZE];

// =========================================================
// TFLite Micro runtime objects
// =========================================================
namespace {
tflite::MicroErrorReporter micro_error_reporter;
tflite::ErrorReporter *error_reporter = &micro_error_reporter;

const tflite::Model    *model       = nullptr;
tflite::MicroInterpreter *interpreter = nullptr;
TfLiteTensor *inputTensor  = nullptr;
TfLiteTensor *outputTensor = nullptr;

// ── Tensor arena in SDRAM ────────────────────────────────────────────────────
// Arena sizing (DrongoNet-edge, INT8 Conv2D inference):
//   Worst-case HEAD during Conv2D: ~251 680 B
//   TAIL metadata:                    ~2 704 B
//   + 20 % safety margin        →  308 KB
constexpr int kTensorArenaSize = 308 * 1024; // 315 392 B
uint8_t *tensor_arena = nullptr; // filled in setup() via SDRAM.malloc()
} // namespace

// =========================================================
// CMSIS-DSP FFT instance + working buffers
// ── DTCM placement ───────────────────────────────────────
// These arrays form the FFT working set (~10 KB total).
// Placing them in DTCM (0x20000000, 128 KB, zero-wait)
// eliminates AXI SRAM cache-miss stalls in arm_rfft_fast_f32.
//
// IMPORTANT: Standard DMA cannot access DTCM on STM32H7.
// captureAudio() uses CPU-polled analogRead() — safe here.
// =========================================================
static arm_rfft_fast_instance_f32 fftInstance; // ~76 B state struct

__attribute__((section(".dtcmram")))
static float hannWindow[MEL_N_FFT];        // 1024 floats = 4 KB → DTCM

__attribute__((section(".dtcmram")))
static float fftBuf[MEL_N_FFT];           // 1024 floats = 4 KB → DTCM (in/out)

__attribute__((section(".dtcmram")))
static float powerSpectrum[MEL_N_FFT_BINS]; // 513 floats = 2 KB → DTCM

// =========================================================
// Flat mel filterbank weight table (pre-baked, no runtime div)
// Total non-zero bins across all 80 filters = 995
// Memory: 995 × 4 B = 3.9 KB BSS
// Layout: melWeightFlat[melFiltersFlat[m].offset .. +width-1]
//         corresponds to powerSpectrum[startBin .. endBin-1]
// =========================================================
#define FLAT_WEIGHT_TOTAL 995

typedef struct {
  int startBin; // index into powerSpectrum[]
  int width;    // number of weights (endBin - startBin)
  int offset;   // index into melWeightFlat[]
} MelFilterFlat;

static float        melWeightFlat[FLAT_WEIGHT_TOTAL]; // 3.9 KB BSS
static MelFilterFlat melFiltersFlat[MEL_N_MELS];     // 80 × 12 B = 960 B BSS

// =========================================================
// RMS energy gate
// RMS_THRESHOLD: ADC units (int16 scale ±32767).
// Start at 500; adjust for your environment.
// =========================================================
#define RMS_THRESHOLD 500.0f

// 3-window ring buffer for temporal confidence smoothing
static float scoreHistory[3]  = {0.0f, 0.0f, 0.0f};
static int   scoreHistIdx      = 0;

// ArgusStageRAM/snapshotRAM/printStageDelta/fast_log10f now live in
// ARGUS_Common.h as ArgusStageRAM/argus_snapshot_ram()/
// argus_print_stage_delta()/argus_fast_log10f() -- see the #include above.

// INA219
Adafruit_INA219 ina219;
static float    total_energy_mWh = 0.0f;
static uint32_t lastPowerMs      = 0;
static bool     ina219_ok        = false;

static bool firstLoopDone = false;

// =========================================================
// Forward declarations
// =========================================================
void printTFLMMemory();
void printFlashMemory();
void printFirmwareRAM();
void captureAudio();
void initMelFFT();
void computeMelSpectrogram(int16_t *audio, int audioLength, float *melOut);

// =========================================================
// FLASH MEMORY BREAKDOWN
// =========================================================
void printFlashMemory() {
  Serial.println(F("\n╔══════════════════════════════════════════╗"));
  Serial.println(F("║        FLASH MEMORY BREAKDOWN            ║"));
  Serial.println(F("╚══════════════════════════════════════════╝"));

  mbed::FlashIAP flash;
  if (flash.init() == 0) {
    uint32_t flash_start = flash.get_flash_start();
    uint32_t flash_size  = flash.get_flash_size();
    // Do NOT call flash.deinit() — on STM32H7, HAL_DeInit() resets the flash
    // peripheral clock, stalling CPU instruction fetch → HardFault crash.

    uint32_t app_end          = FLASHIAP_APP_ROM_END_ADDR;
    uint32_t app_size         = app_end - flash_start;
    uint32_t remaining_after  = (flash_start + flash_size) - app_end;
    uint32_t model_size       = drongonet_edge_len;
    uint32_t remaining_before = remaining_after + model_size;

    Serial.print(F("  Total Flash Size            : "));
    Serial.print(flash_size);
    Serial.print(F(" B  = "));
    Serial.print(flash_size / 1024.0f / 1024.0f, 2);
    Serial.println(F(" MB"));

    Serial.print(F("  Flash Start Address         : 0x"));
    Serial.println(flash_start, HEX);

    Serial.print(F("  Application End Address     : 0x"));
    Serial.println(app_end, HEX);

    Serial.print(F("  Application Size (with model): "));
    Serial.print(app_size);
    Serial.print(F(" B  = "));
    Serial.print(app_size / 1024.0f, 2);
    Serial.println(F(" KB"));

    Serial.print(F("  Model Size in Flash         : "));
    Serial.print(model_size);
    Serial.print(F(" B  = "));
    Serial.print(model_size / 1024.0f, 2);
    Serial.println(F(" KB  (DrongoNet-edge)"));

    Serial.println(F("  ──────────────────────────────────────────"));
    Serial.print(F("  Remaining Flash BEFORE model loaded : "));
    Serial.print(remaining_before);
    Serial.print(F(" B  = "));
    Serial.print(remaining_before / 1024.0f, 2);
    Serial.println(F(" KB"));

    Serial.print(F("  Remaining Flash AFTER model loaded  : "));
    Serial.print(remaining_after);
    Serial.print(F(" B  = "));
    Serial.print(remaining_after / 1024.0f, 2);
    Serial.println(F(" KB"));
  } else {
    Serial.println(F("  [ERR] Failed to initialize FlashIAP."));
  }
}

// =========================================================
// TFLM MEMORY BREAKDOWN
// =========================================================
void printTFLMMemory() {
  Serial.println(F("\n╔══════════════════════════════════════════╗"));
  Serial.println(F("║        TFLM MEMORY BREAKDOWN             ║"));
  Serial.println(F("╚══════════════════════════════════════════╝"));

  Serial.print(F("  [FLASH] Model flat-buffer   : "));
  Serial.print(drongonet_edge_len);
  Serial.print(F(" B  = "));
  Serial.print(drongonet_edge_len / 1024.0f, 2);
  Serial.println(F(" KB  (DrongoNet-edge)"));

  uint32_t arena_used  = (uint32_t)interpreter->arena_used_bytes();
  uint32_t arena_slack = (uint32_t)kTensorArenaSize - arena_used;

  Serial.print(F("  [SDRAM] Arena allocated     : "));
  Serial.print(kTensorArenaSize);
  Serial.print(F(" B  = "));
  Serial.print(kTensorArenaSize / 1024.0f, 1);
  Serial.println(F(" KB  (kTensorArenaSize, SDRAM)"));

  Serial.print(F("  [SDRAM] Arena used          : "));
  Serial.print(arena_used);
  Serial.print(F(" B  = "));
  Serial.print(arena_used / 1024.0f, 2);
  Serial.println(F(" KB  (HEAD+TAIL)"));

  Serial.print(F("  [SDRAM] Arena slack         : "));
  Serial.print(arena_slack);
  Serial.print(F(" B  = "));
  Serial.print(arena_slack / 1024.0f, 2);
  Serial.println(F(" KB  ← reduce kTensorArenaSize to (used × 1.12) once stable"));

  Serial.print(F("  [SDRAM] Input tensor bytes  : "));
  Serial.print(inputTensor->bytes);
  Serial.print(F(" B  shape=["));
  for (int i = 0; i < inputTensor->dims->size; i++) {
    Serial.print(inputTensor->dims->data[i]);
    if (i < inputTensor->dims->size - 1)
      Serial.print(',');
  }
  Serial.print(F("]  scale="));
  Serial.print(inputTensor->params.scale, 6);
  Serial.print(F("  zp="));
  Serial.println(inputTensor->params.zero_point);

  Serial.print(F("  [SDRAM] Output tensor bytes : "));
  Serial.print(outputTensor->bytes);
  Serial.println(F(" B  (INT8 × 2: [P(no_bird), P(bird)] softmax)"));

  uint32_t recommended = (uint32_t)(arena_used * 1.12f);
  Serial.print(F("  Recommended minimum arena : "));
  Serial.print(recommended);
  Serial.print(F(" B  = "));
  Serial.print(recommended / 1024.0f, 1);
  Serial.println(F(" KB  (used × 1.12)"));
}

// =========================================================
// FIRMWARE RAM BREAKDOWN
// =========================================================
void printFirmwareRAM() {
  Serial.println(F("\n╔══════════════════════════════════════════╗"));
  Serial.println(F("║      FIRMWARE RAM BREAKDOWN              ║"));
  Serial.println(F("╚══════════════════════════════════════════╝"));

  Serial.println(F("  [AXI SRAM / .bss  — static globals]"));
  Serial.print(F("    audioBuffer[48000×int16]  : "));
  Serial.print((uint32_t)BUFFER_SIZE * sizeof(int16_t));
  Serial.println(F(" B  = 96000 B  (93.75 KB, in .bss / AXI SRAM)"));

  Serial.print(F("    melFeatures[14720×float]  : "));
  Serial.print((uint32_t)INPUT_SIZE * sizeof(float));
  Serial.println(F(" B  = 58880 B  (57.5 KB, in .bss / AXI SRAM)"));

  Serial.print(F("    hannWindow[1024×float]    : "));
  Serial.print((uint32_t)MEL_N_FFT * sizeof(float));
  Serial.println(F(" B  = 4096 B  (4 KB, DTCM)"));

  Serial.print(F("    fftBuf[1024×float]        : "));
  Serial.print((uint32_t)MEL_N_FFT * sizeof(float));
  Serial.println(F(" B  = 4096 B  (4 KB, DTCM)"));

  Serial.print(F("    powerSpectrum[513×float]  : "));
  Serial.print((uint32_t)MEL_N_FFT_BINS * sizeof(float));
  Serial.println(F(" B  = 2052 B  (~2 KB, DTCM)"));

  Serial.print(F("    melWeightFlat[995×float]  : "));
  Serial.print((uint32_t)FLAT_WEIGHT_TOTAL * sizeof(float));
  Serial.println(F(" B  = 3980 B  (~3.9 KB, .bss / AXI SRAM)"));

  Serial.println(F("    AllOpsResolver (static)  : ~30-50 KB  (in .bss / AXI SRAM)"));

  Serial.println(F("  [SDRAM — 8 MB at 0x60000000]"));
  Serial.print(F("    tensor_arena[kArenaSize]  : "));
  Serial.print((uint32_t)kTensorArenaSize);
  Serial.print(F(" B  = "));
  Serial.print(kTensorArenaSize / 1024.0f, 0);
  Serial.println(F(" KB  (SDRAM.malloc — NOT in AXI SRAM)"));

  mbed_stats_heap_t heap;
  mbed_stats_heap_get(&heap);
  Serial.println(F("  [HEAP  — dynamic Mbed allocations]"));
  Serial.print(F("    current live bytes        : "));
  Serial.print(heap.current_size);
  Serial.println(F(" B"));
  Serial.print(F("    peak (max ever)           : "));
  Serial.print(heap.max_size / 1024.0f, 2);
  Serial.println(F(" KB"));
  Serial.print(F("    alloc failures            : "));
  Serial.println(heap.alloc_fail_cnt);

  Serial.println(F("  [STACK — Mbed OS HWM per thread]"));
  int cnt = osThreadGetCount();
  if (cnt > 0 && cnt <= 32) {
    mbed_stats_stack_t *stk =
        (mbed_stats_stack_t *)malloc(cnt * sizeof(mbed_stats_stack_t));
    if (stk) {
      int got = mbed_stats_stack_get_each(stk, cnt);
      for (int i = 0; i < got; i++) {
        uint32_t used = stk[i].max_size;
        uint32_t res  = stk[i].reserved_size;
        Serial.print(F("    Thread 0x"));
        Serial.print(stk[i].thread_id, HEX);
        Serial.print(F("  HWM="));
        Serial.print(used);
        Serial.print(F("B / res="));
        Serial.print(res);
        Serial.print(F("B  free="));
        Serial.println((res > used) ? (res - used) : 0);
      }
      free(stk);
    }
  }

  // ── Transient RAM summary ────────────────────────────────
  uint32_t stack_free = 0;
  int cnt2 = osThreadGetCount();
  if (cnt2 > 0 && cnt2 <= 32) {
    mbed_stats_stack_t *stk =
        (mbed_stats_stack_t *)malloc(cnt2 * sizeof(mbed_stats_stack_t));
    if (stk) {
      int got      = mbed_stats_stack_get_each(stk, cnt2);
      uint32_t max_res = 0;
      for (int i = 0; i < got; i++) {
        if (stk[i].reserved_size > max_res) {
          max_res    = stk[i].reserved_size;
          stack_free = (stk[i].reserved_size > stk[i].max_size)
                         ? (stk[i].reserved_size - stk[i].max_size) : 0;
        }
      }
      free(stk);
    }
  }

  uint32_t heap_free   = (heap.reserved_size > heap.current_size)
                           ? (heap.reserved_size - heap.current_size) : 0;
  uint32_t arena_used  = (uint32_t)interpreter->arena_used_bytes();
  uint32_t arena_slack = (uint32_t)kTensorArenaSize - arena_used;
  uint32_t internal_free = stack_free + heap_free;

  Serial.println(F("  [TRANSIENT RAM SUMMARY]"));
  Serial.print(F("    Remaining Main Stack Space (Internal) : "));
  Serial.print(stack_free);
  Serial.println(F(" B"));
  Serial.print(F("    Remaining Mbed Heap Space  (Internal) : "));
  Serial.print(heap_free);
  Serial.println(F(" B"));
  Serial.print(F("    Unused Tensor Arena Slack  (External) : "));
  Serial.print(arena_slack);
  Serial.println(F(" B"));
  Serial.println(F("    ──────────────────────────────────────────"));
  Serial.print(F("    Total Free Internal Transient RAM (SRAM)  : "));
  Serial.print(internal_free);
  Serial.print(F(" B  = "));
  Serial.print(internal_free / 1024.0f, 2);
  Serial.println(F(" KB"));
  Serial.print(F("    Total Free External Transient RAM (SDRAM) : "));
  Serial.print(arena_slack);
  Serial.print(F(" B  = "));
  Serial.print(arena_slack / 1024.0f, 2);
  Serial.println(F(" KB"));
}

// =========================================================
// CMSIS-DSP FFT + Hann Window + Filterbank Initialisation
// =========================================================
// Call once from setup(). Computes the 1024-point Hann window,
// initialises the CMSIS Real-FFT instance, and pre-bakes the
// flat triangular filterbank weight table.
//
// Why arm_rfft_fast_f32?
//   • Real FFT exploits conjugate symmetry → ~2× faster than
//     the equivalent complex FFT for the same N.
//   • CMSIS assembly is hand-optimised for Cortex-M7 FPU/SIMD.
void initMelFFT() {
  // ── Hann window ────────────────────────────────────────────
  for (int i = 0; i < MEL_N_FFT; i++) {
    hannWindow[i] = 0.5f * (1.0f - cosf(2.0f * (float)M_PI * i / (float)MEL_N_FFT));
  }

  // ── CMSIS Real-FFT instance ─────────────────────────────────
  arm_rfft_fast_init_f32(&fftInstance, MEL_N_FFT);

  // ── Pre-bake flat filterbank weight table ───────────────────
  // For each mel filter m, the triangular weight at FFT bin k:
  //   rising  (startBin ≤ k < peakBin):  w = (k - start) / (peak - start)
  //   falling (peakBin  ≤ k < endBin):   w = (end - k)   / (end  - peak)
  int offset = 0;
  for (int m = 0; m < MEL_N_MELS; m++) {
    int s = melFilters[m].startBin;
    int p = melFilters[m].peakBin;
    int e = melFilters[m].endBin;
    int width = e - s;
    melFiltersFlat[m].startBin = s;
    melFiltersFlat[m].width    = width;
    melFiltersFlat[m].offset   = offset;
    float rise_inv = (p > s) ? 1.0f / (float)(p - s) : 0.0f;
    float fall_inv = (e > p) ? 1.0f / (float)(e - p) : 0.0f;
    for (int k = s; k < e; k++) {
      float w;
      if (k < p)       w = (float)(k - s) * rise_inv; // rising
      else if (k == p) w = 1.0f;                       // peak
      else             w = (float)(e - k) * fall_inv;  // falling
      melWeightFlat[offset + (k - s)] = w;
    }
    offset += width;
  }
}

// =========================================================
// Mel Spectrogram — FFT-based, matching DrongoNet-edge training
// =========================================================
//
// Reproduces this librosa chain on the MCU:
//   mel_spec = librosa.feature.melspectrogram(
//       y=waveform, sr=16000, n_fft=1024, hop_length=256,
//       n_mels=80, fmin=100, fmax=8000, center=False)
//   mel_db   = librosa.power_to_db(mel_spec, ref=np.max)
//   mel_norm = (mel_db - mel_db.min()) / (mel_db.max() - mel_db.min() + 1e-8)
//
// PIPELINE (per frame):
//   1. int16 → float + Hann window (fused, single pass)
//   2. arm_rfft_fast_f32 (hardware Real FFT, N=1024)
//   3. |X[k]|² power spectrum (DC + Nyquist + SIMD bins 1..511)
//   4. Triangular mel filterbank dot-product (4-way unrolled)
//   5. Power → dB (fast_log10f IEEE-754 trick)
//   6. Global min-max normalisation (SIMD arm_offset + arm_scale)
//
// OUTPUT: melOut[f * MEL_N_MELS + m] in [0, 1], row-major (time × mel)
// ─────────────────────────────────────────────────────────────────
void computeMelSpectrogram(int16_t *audio, int audioLength, float *melOut) {

  for (int f = 0; f < TIME_FRAMES; f++) {
    int frameStart   = f * MEL_HOP_LENGTH;
    int validSamples = audioLength - frameStart;
    if (validSamples > MEL_N_FFT) validSamples = MEL_N_FFT;

    // ── 1. Fused int16→float + Hann window (OPT-A) ────────────────
    // Avoids a separate arm_q15_to_float + arm_mult_f32 pass.
    // Single write: fftBuf[i] = audio[i] * hannScaled[i]
    const float INV_32768 = 1.0f / 32768.0f;
    const int16_t *src = &audio[frameStart];
    for (int i = 0; i < validSamples; i++) {
      fftBuf[i] = (float)src[i] * (hannWindow[i] * INV_32768);
    }
    // Zero-pad the tail (only the last frame is ever short)
    if (validSamples < MEL_N_FFT) {
      memset(&fftBuf[validSamples], 0,
             (MEL_N_FFT - validSamples) * sizeof(float));
    }

    // ── 2. Real FFT (CMSIS hardware-accelerated) ───────────────────
    // Output packing in fftBuf[0..N-1]:
    //   fftBuf[0]    = DC   component (real only)
    //   fftBuf[1]    = Nyquist component (real only)
    //   fftBuf[2k]   = Re[k]  for k = 1..N/2-1
    //   fftBuf[2k+1] = Im[k]  for k = 1..N/2-1
    arm_rfft_fast_f32(&fftInstance, fftBuf, fftBuf, 0 /*forward*/);

    // ── 3. Power spectrum |X[k]|² for k = 0..N/2 ──────────────────
    // DC bin (k=0): fftBuf[0]^2
    powerSpectrum[0] = fftBuf[0] * fftBuf[0];
    // Nyquist bin (k=N/2): fftBuf[1]^2
    powerSpectrum[MEL_N_FFT / 2] = fftBuf[1] * fftBuf[1];
    // Bins 1..N/2-1: arm_cmplx_mag_squared_f32 computes Re²+Im²
    arm_cmplx_mag_squared_f32(&fftBuf[2], &powerSpectrum[1],
                              MEL_N_FFT / 2 - 1);

    // ── 4+5. Filterbank dot-product → dB (OPT-B: 4-way unrolled) ──
    // Replaces mel_bins × arm_dot_prod_f32() calls with an inline
    // 4-wide unrolled loop that the compiler can dual-issue on M7.
    float *melRow = &melOut[f * MEL_N_MELS];
    for (int m = 0; m < MEL_N_MELS; m++) {
      const float *P = &powerSpectrum[melFiltersFlat[m].startBin];
      const float *W = &melWeightFlat[melFiltersFlat[m].offset];
      int   width    =  melFiltersFlat[m].width;

      float acc0 = 0.0f, acc1 = 0.0f, acc2 = 0.0f, acc3 = 0.0f;
      int k = 0;
      for (; k <= width - 4; k += 4) {
        acc0 += P[k+0] * W[k+0];
        acc1 += P[k+1] * W[k+1];
        acc2 += P[k+2] * W[k+2];
        acc3 += P[k+3] * W[k+3];
      }
      float acc = (acc0 + acc1) + (acc2 + acc3);
      for (; k < width; k++) {
        acc += P[k] * W[k];
      }

      // Power → dB using fast IEEE-754 log10 approximation
      melRow[m] = 10.0f * argus_fast_log10f(acc + 1e-10f);
    }
  } // end frame loop

  // ── 6. Global min-max normalisation (OPT-C: SIMD) ─────────────
  // Matches training pipeline:
  //   mel_norm = (mel_db - mel_db.min()) / (mel_db.max() - mel_db.min())
  // arm_min/max_f32: SIMD scan, 4 float/cycle
  // arm_offset_f32:  out[i] = in[i] + offset  (SIMD)
  // arm_scale_f32:   out[i] = in[i] * scale   (SIMD)
  float globalMin, globalMax;
  uint32_t minIdx, maxIdx;
  arm_min_f32(melOut, INPUT_SIZE, &globalMin, &minIdx);
  arm_max_f32(melOut, INPUT_SIZE, &globalMax, &maxIdx);

  float range = globalMax - globalMin;
  if (range < 1e-6f) range = 1e-6f;
  float invRange = 1.0f / range;

  arm_offset_f32(melOut, -globalMin, melOut, INPUT_SIZE);
  arm_scale_f32(melOut, invRange, melOut, INPUT_SIZE);

  // Clamp to [0, 1] for numeric safety
  for (int i = 0; i < INPUT_SIZE; i++) {
    float v = melOut[i];
    if (v < 0.0f) v = 0.0f;
    if (v > 1.0f) v = 1.0f;
    melOut[i] = v;
  }
}

// =========================================================
// Audio capture — busy-wait precise timing at 16 kHz
// NOTE: Portenta H7 default ADC is 12-bit (0–4095).
//       Centre at 2048, full-scale ±2048.
// =========================================================
void captureAudio() {
  const unsigned long sampleInterval = 1000000UL / SAMPLE_RATE;
  unsigned long lastSample = micros();
  for (int i = 0; i < BUFFER_SIZE; i++) {
    while (micros() - lastSample < sampleInterval) {
    }
    lastSample = micros();
    int val = analogRead(MIC_PIN);
    // 12-bit ADC: centre at 2048, full-scale ±2048
    float sample = ((float)val - 2048.0f) / 2048.0f;
    audioBuffer[i] = (int16_t)(sample * 32767);
  }
}

// =========================================================
// SETUP
// =========================================================
void setup() {
  Serial.begin(115200);
  pinMode(LED_BUILTIN, OUTPUT);
  delay(2000);

  // ── Enable DWT Cycle Counter ────────────────────────────────────
  DWT_ENABLE();

  Serial.println(F("=== DrongoNet-edge (80-mel) — Memory Profiling Build ==="));
  Serial.print(F("MEL_BINS="));   Serial.print(MEL_BINS);
  Serial.print(F("  TIME_FRAMES=")); Serial.print(TIME_FRAMES);
  Serial.print(F("  INPUT_SIZE=")); Serial.println(INPUT_SIZE);
  Serial.print(F("FFT_SIZE="));    Serial.print(MEL_N_FFT);
  Serial.print(F("  HOP="));       Serial.print(MEL_HOP_LENGTH);
  Serial.print(F("  FMIN="));      Serial.print(MEL_FMIN);
  Serial.print(F("  FMAX="));      Serial.println(MEL_FMAX);

  // ── Step 0: Initialise SDRAM ─────────────────────────────────────
  SDRAM.begin();
  Serial.println(F("[OK]  SDRAM initialised (8 MB at 0x60000000)."));

  // ── Step 1: Allocate tensor arena from SDRAM ──────────────────────
  uint8_t *raw = (uint8_t *)SDRAM.malloc(kTensorArenaSize + 15);
  if (!raw) {
    Serial.println(F("[ERR] SDRAM.malloc() failed for tensor_arena."));
    while (1) { digitalWrite(LED_BUILTIN, !digitalRead(LED_BUILTIN)); delay(200); }
  }
  uintptr_t addr    = (uintptr_t)raw;
  uintptr_t aligned = (addr + 15u) & ~15u;
  tensor_arena = (uint8_t *)aligned;

  Serial.print(F("[OK]  tensor_arena allocated in SDRAM at 0x"));
  Serial.print((uint32_t)tensor_arena, HEX);
  Serial.print(F(", size = "));
  Serial.print(kTensorArenaSize / 1024);
  Serial.println(F(" KB."));

  // ── INA219 ──────────────────────────────────────────────────────
  Wire.begin();
  if (ina219.begin()) {
    ina219_ok    = true;
    lastPowerMs  = millis();
    Serial.println(F("[OK]  INA219 initialised."));
  } else {
    Serial.println(F("[WARN] INA219 not found — power data skipped."));
  }

  // ── Load model ────────────────────────────────────────────────────
  model = tflite::GetModel(drongonet_edge);
  if (!model) {
    Serial.println(F("[ERR] tflite::GetModel() returned null."));
    while (1) {}
  }
  if (model->version() != TFLITE_SCHEMA_VERSION) {
    Serial.print(F("[ERR] Schema mismatch: got="));
    Serial.print(model->version());
    Serial.print(F(" expected="));
    Serial.println(TFLITE_SCHEMA_VERSION);
    while (1) {}
  }

  // ── Build interpreter ─────────────────────────────────────────────
  // AllOpsResolver: DrongoNet-edge uses only standard ops
  // (CONV_2D, MAX_POOL_2D, MEAN, FULLY_CONNECTED, RELU, SOFTMAX).
  static tflite::AllOpsResolver resolver;
  static tflite::MicroInterpreter static_interpreter(
      model, resolver, tensor_arena, kTensorArenaSize);
  interpreter = &static_interpreter;

  // ── Allocate tensors ──────────────────────────────────────────────
  TfLiteStatus alloc_status = interpreter->AllocateTensors();
  if (alloc_status != kTfLiteOk) {
    Serial.println(F("[ERR] AllocateTensors() failed."));
    Serial.print(F("      Current arena = "));
    Serial.print(kTensorArenaSize / 1024);
    Serial.println(F(" KB — increase kTensorArenaSize and reflash."));
    while (1) {}
  }

  inputTensor  = interpreter->input(0);
  outputTensor = interpreter->output(0);

  // Sanity-check: input must match MEL_BINS × TIME_FRAMES (INT8 → 1 B/elem)
  if (inputTensor->bytes != (uint32_t)INPUT_SIZE) {
    Serial.print(F("[ERR] Input tensor byte count mismatch: model expects "));
    Serial.print(inputTensor->bytes);
    Serial.print(F(" B but firmware has INPUT_SIZE="));
    Serial.println(INPUT_SIZE);
    Serial.println(F("      Check MEL_BINS and TIME_FRAMES constants."));
    while (1) {}
  }

  // Sanity-check: output must be 2-element (softmax)
  if (outputTensor->bytes != 2) {
    Serial.print(F("[WARN] Expected 2-element softmax output, got "));
    Serial.print(outputTensor->bytes);
    Serial.println(F(" bytes — output decoding may be wrong."));
  }

  // ── Initialise CMSIS-DSP FFT + Hann window + filterbank ──────────
  initMelFFT();
  Serial.println(F("[OK]  CMSIS-DSP RFFT + Hann window + mel filterbank initialised."));
  Serial.print(F("      FFT size: ")); Serial.print(MEL_N_FFT);
  Serial.print(F("  hop: "));         Serial.print(MEL_HOP_LENGTH);
  Serial.print(F("  mels: "));        Serial.println(MEL_N_MELS);

  printFlashMemory();
  printTFLMMemory();
  printFirmwareRAM();

  Serial.println(F("\n[OK]  DrongoNet-edge (80-mel) inference engine ready."));
}

// =========================================================
// MAIN LOOP
// =========================================================
void loop() {

  if (!firstLoopDone) {
    Serial.println();
    Serial.println(F("========== PIPELINE BUFFER INFO =========="));
    Serial.print(F("audioBuffer [48000×int16]  : "));
    Serial.print(BUFFER_SIZE * (uint32_t)sizeof(int16_t));
    Serial.println(F(" B  (global .bss / AXI SRAM)"));
    Serial.print(F("melFeatures [14720×float]  : "));
    Serial.print(INPUT_SIZE * (uint32_t)sizeof(float));
    Serial.println(F(" B  (global .bss / AXI SRAM)"));
    Serial.print(F("tensor input buf           : "));
    Serial.print(inputTensor->bytes);
    Serial.println(F(" B  (arena HEAD, SDRAM)"));
    Serial.print(F("tensor output buf          : "));
    Serial.print(outputTensor->bytes);
    Serial.println(F(" B  (arena HEAD, 2-element softmax, SDRAM)"));
    Serial.print(F("Input tensor dims          : ["));
    for (int i = 0; i < inputTensor->dims->size; i++) {
      Serial.print(inputTensor->dims->data[i]);
      if (i < inputTensor->dims->size - 1)
        Serial.print(',');
    }
    Serial.println(F("]"));
    Serial.println(F("==========================================\n"));
    firstLoopDone = true;
  }

  unsigned long startTime = millis();

  // ── STAGE 1: Audio capture ───────────────────────────────────────
  ArgusStageRAM before_capture = argus_snapshot_ram();
  captureAudio();
  ArgusStageRAM after_capture = argus_snapshot_ram();
  unsigned long captureTime = millis() - startTime;

  // ── RMS Energy Gate ──────────────────────────────────────────────
  // Compute RMS of the captured int16 buffer.
  // Below RMS_THRESHOLD → silence/background; skip inference.
  // This prevents per-sample min-max from amplifying silence
  // into a false-positive input to the model.
  float rmsAccum = 0.0f;
  for (int i = 0; i < BUFFER_SIZE; i++) {
    float s = (float)audioBuffer[i];
    rmsAccum += s * s;
  }
  float rms = sqrtf(rmsAccum / (float)BUFFER_SIZE);

  if (rms < RMS_THRESHOLD) {
    Serial.print(F("[GATE] Silent window — RMS="));
    Serial.print(rms, 1);
    Serial.print(F(" < threshold="));
    Serial.print(RMS_THRESHOLD, 0);
    Serial.println(F(" — inference skipped."));
    delay(100);
    return;
  }

  // ── STAGE 2: Mel Spectrogram (FFT-based) ─────────────────────────
  ArgusStageRAM before_mel = argus_snapshot_ram();

  // DWT-based cycle measurement for µs-accurate mel timing.
  DWT_RESET();
  unsigned long melStart = millis();
  computeMelSpectrogram(audioBuffer, BUFFER_SIZE, melFeatures);
  uint32_t melCycles = DWT_CYCLES(); // read immediately after return
  unsigned long melTime = millis() - melStart;
  float melUs = DWT_US(melCycles);

  ArgusStageRAM after_mel = argus_snapshot_ram();

  // ── STAGE 3: Quantise and fill input tensor ───────────────────────
  // melFeatures[] is in [0, 1]; dequantise to INT8 using
  // the tensor's affine quantisation parameters (scale, zero_point).
  for (int i = 0; i < INPUT_SIZE; i++) {
    float scaled = melFeatures[i] / inputTensor->params.scale +
                   inputTensor->params.zero_point;
    if (scaled >  127.0f) scaled =  127.0f;
    if (scaled < -128.0f) scaled = -128.0f;
    inputTensor->data.int8[i] = (int8_t)scaled;
  }

  // ── STAGE 4: Inference ────────────────────────────────────────────
  ArgusStageRAM before_infer = argus_snapshot_ram();
  unsigned long inferStart = millis();
  TfLiteStatus invoke_status = interpreter->Invoke();
  unsigned long inferTime = millis() - inferStart;
  ArgusStageRAM after_infer = argus_snapshot_ram();

  if (invoke_status != kTfLiteOk) {
    Serial.println(F("[ERR] Invoke() failed — check arena size / model compatibility."));
    return;
  }

  // ── STAGE 5: Decode output ────────────────────────────────────────
  // 2-element INT8 softmax output.
  // [0] = P(no_bird)    [1] = P(bird)
  float out_scale = outputTensor->params.scale;
  int   out_zp    = outputTensor->params.zero_point;

  float prob_no_bird = (outputTensor->data.int8[0] - out_zp) * out_scale;
  float prob_bird    = (outputTensor->data.int8[1] - out_zp) * out_scale;

  // One-time output diagnostic
  static bool outputDiagPrinted = false;
  if (!outputDiagPrinted) {
    outputDiagPrinted = true;
    Serial.println(F("\n--- OUTPUT DIAGNOSTIC ---"));
    Serial.print(F("  outputTensor->bytes = ")); Serial.println(outputTensor->bytes);
    Serial.print(F("  scale = "));   Serial.print(out_scale, 6);
    Serial.print(F("  zp = "));      Serial.println(out_zp);
    Serial.print(F("  raw int8[0] = ")); Serial.print(outputTensor->data.int8[0]);
    Serial.print(F("  raw int8[1] = ")); Serial.println(outputTensor->data.int8[1]);
    Serial.print(F("  P(no_bird) = ")); Serial.print(prob_no_bird, 4);
    Serial.print(F("  P(bird) = "));    Serial.println(prob_bird, 4);
    Serial.println(F("--- END OUTPUT DIAGNOSTIC ---\n"));
  }

  // ── Temporal smoothing (3-window ring buffer) ─────────────────────
  scoreHistory[scoreHistIdx % 3] = prob_bird;
  scoreHistIdx++;
  float avgScore = (scoreHistory[0] + scoreHistory[1] + scoreHistory[2]) / 3.0f;
  bool  birdDetected = (avgScore > 0.6f);
  digitalWrite(LED_BUILTIN, birdDetected ? HIGH : LOW);

  // ── Print inference result ─────────────────────────────────────────
  Serial.print(F("Detection: "));
  Serial.print(birdDetected ? F("BIRD") : F("no bird"));
  Serial.print(F(" | P(bird)="));   Serial.print(prob_bird, 4);
  Serial.print(F(" | P(no_bird)=")); Serial.print(prob_no_bird, 4);
  Serial.print(F(" | AvgScore="));  Serial.print(avgScore, 4);
  Serial.print(F(" | RMS="));       Serial.print(rms, 0);
  Serial.print(F(" | capture="));   Serial.print(captureTime);
  Serial.print(F("ms mel="));       Serial.print(melTime);
  Serial.print(F("ms infer="));     Serial.print(inferTime);
  Serial.print(F("ms | mel_cyc=")); Serial.print(melCycles);
  Serial.print(F(" mel_us="));      Serial.print(melUs, 1);
  Serial.println(F(" µs"));

  // ── Per-stage RAM deltas (every 10 loops) ─────────────────────────
  static uint32_t loopCount = 0;
  const uint32_t LOG_INTERVAL = 10;
  if (++loopCount % LOG_INTERVAL == 0) {
    Serial.println(F("\n--- Transient RAM per pipeline stage ---"));
    argus_print_stage_delta("1_capture", before_capture, after_capture);
    argus_print_stage_delta("2_mel    ", before_mel, after_mel);
    argus_print_stage_delta("3_infer  ", before_infer, after_infer);

    mbed_stats_heap_t heap;
    mbed_stats_heap_get(&heap);
    Serial.print(F("  Heap: current="));
    Serial.print(heap.current_size);
    Serial.print(F("B  peak="));
    Serial.print(heap.max_size);
    Serial.print(F("B  failures="));
    Serial.println(heap.alloc_fail_cnt);
    Serial.println(F("----------------------------------------\n"));
  }

  // ── Power & Energy Breakdown ─────────────────────────────────────────
  // Single INA219 snapshot after all compute stages complete.
  // Cortex-M7 @ 480 MHz runs at 100% duty cycle during mel + infer,
  // so instantaneous power represents the active load well.
  // E(µJ) = P(mW) × t(ms)   [mW × ms = µW·s = µJ]
  if (ina219_ok) {
    float busV   = ina219.getBusVoltage_V();
    float cur_mA = ina219.getCurrent_mA();
    float pwr_mW = ina219.getPower_mW();

    // Accumulate session energy (whole loop wall-clock time)
    uint32_t now = millis();
    float dt_h   = (now - lastPowerMs) / 3600000.0f;
    lastPowerMs  = now;
    if (pwr_mW > 0.0f)
      total_energy_mWh += pwr_mW * dt_h;

    // Per-stage energy derived from DWT / millis() durations
    float energy_mel_uJ   = pwr_mW * (float)melTime;    // mel computation
    float energy_infer_uJ = pwr_mW * (float)inferTime;  // inference
    float energy_total_uJ = pwr_mW * (float)(melTime + inferTime); // active compute

    Serial.println(F("\n─────────── Power & Energy ──────────────"));
    Serial.print(F("  Instantaneous  : "));
    Serial.print(pwr_mW, 2);
    Serial.print(F(" mW  ("));
    Serial.print(busV, 2);
    Serial.print(F(" V, "));
    Serial.print(cur_mA, 2);
    Serial.println(F(" mA)"));
    Serial.println(F("  [Energy — current cycle]"));
    Serial.print(F("    Mel computation : "));
    Serial.print(energy_mel_uJ, 2);
    Serial.println(F(" µJ"));
    Serial.print(F("    Inference       : "));
    Serial.print(energy_infer_uJ, 2);
    Serial.println(F(" µJ"));
    Serial.print(F("    Total (active)  : "));
    Serial.print(energy_total_uJ, 2);
    Serial.println(F(" µJ"));
    Serial.print(F("  Session cumulative: "));
    Serial.print(total_energy_mWh, 6);
    Serial.println(F(" mWh"));
    Serial.println(F("─────────────────────────────────────────"));
  }

  Serial.println();
  delay(100);
}
